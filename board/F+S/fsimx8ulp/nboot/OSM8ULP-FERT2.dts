// SPDX-License-Identifier: GPL-2.0+
/*
* Copyright 2024 F&S Elektronik Systeme GmbH
*
* This program is free software; you can redistribute it and/or modify
* it under the terms of the GNU General Public License version 2 as
* published by the Free Software Foundation.
*
* This program is distributed in the hope that it will be useful,
* but WITHOUT ANY WARRANTY; without even the implied warranty of
* MERCHANTABILITY or FITNESS FOR A PARTICULAR PURPOSE.  See the
* GNU General Public License for more details.
*/

/dts-v1/;

#include "nboot-info.dtsi"

/ {
	board-cfg {
		board-name = "FS-OSM-SF-MX8ULP";
		board-fdt = "fs-osm-sf-mx8ulp-adp-osm-bb";

		/* DRAM: B.ICDRAM.30 */
		dram-type = "lpddr4";
		dram-timing = "lpddr4_osm_2g1056m2ch1cs";
		dram-size = <0x800>;		/* In MiB */
		dram-chips = <1>;

		/* Boot-Device: NAND | MMC1/2/3 | SD1/2/3 */
		boot-dev = "MMC1";

		/* Fuse settings, fuse-bankword: MSW: Bank, LSW: Fuse-Word */
        /* 1: MMC Bus widht | 2. Boot from Fuses */
		fuse-bankword = <0x00040001 0x00030007>;
		fuse-mask =     <0x00c00000 0x00008000>;
		fuse-value =    <0x00c00000 0x00008000>;

		/* Common board features */
		have-emmc;
		have-ext-rtc;
		have-eeprom;
		have-eth;
		// have-eth-phy;
		// have-audio-apd;
		// have-audio-rtd;
		// have-wlan;
		have-sd-a;
		// have-sd-b;
		// have-rgb;
		have-mipi-dsi;
		have-mipi-csi;

        OSM8ULP-FERT2.100 {
            board-rev = <100>;
        };
	};
};