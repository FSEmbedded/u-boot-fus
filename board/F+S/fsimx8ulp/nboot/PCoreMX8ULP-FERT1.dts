/*
 * Copyright (C) 2024 F&S Elektronik Systeme GmbH
 *
 * This program is free software; you can redistribute it and/or modify
 * it under the terms of the GNU General Public License version 2 as
 * published by the Free Software Foundation.
 */

/dts-v1/;

#include "nboot-info.dtsi"

/ {
	board-cfg {
		board-name = "PicoCoreMX8ULP";
		board-fdt = "picocoremx8ulp";

        /* DRAM: B.ICDRAM.30 */
		dram-type = "lpddr4";
		dram-timing = "lpddr4_pc_2g1056m2ch1cs";
		dram-size = <0x800>;		/* In MiB */
		dram-chips = <1>;

		/* Boot-Device: NAND | MMC1/2/3 | SD1/2/3 */
		boot-dev = "MMC1";

		/* Fuse settings, fuse-bankword: MSW: Bank, LSW: Fuse-Word */
        /* 1: MMC Bus widht | 2. Boot from Fuses */
		fuse-bankword = <0x00040001 0x00030007>;
		fuse-mask =     <0x00c00000 0x00008000>;
		fuse-value =    <0x00c00000 0x00008000>;

		/* Common board features */
		have-ext-rtc;
		have-emmc;
		have-eeprom;
		have-eth;
		have-eth-phy;
		have-audio-apd;
		have-audio-rtd;
		have-wlan;
		have-sd-a;
		// have-sd-b;
		// have-rgb;
		have-mipi-dsi;
		have-mipi-csi;

        PCoreMX8ULP-FERT1.110 {
            board-rev = <110>;
        };
	};
};