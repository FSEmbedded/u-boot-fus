/*
 * Copyright (C) 2025 F&S Elektronik Systeme GmbH
 *
 * This program is free software; you can redistribute it and/or modify
 * it under the terms of the GNU General Public License version 2 as
 * published by the Free Software Foundation.
 */

/dts-v1/;

#include "nboot-info.dtsi"

/ {
	board-cfg {
		board-name = "OSM8MP";

		/* DRAM: 2GB Samsung B.ICDRAM.41 */
		dram-type = "lpddr4";
		dram-timing = "lpddr4_os_1g2000m2ch1cs";
		dram-size = <0x400>;		/* In MiB */
		dram-chips = <1>;

		/* Boot-Device: NAND | MMC1/2/3 | SD1/2/3 */
		boot-dev = "MMC1";

		/* Fuse settings, fuse-bankword: MSW: Bank, LSW: Fuse-Word */
		fuse-bankword = <0x00010003>;
		fuse-mask =     <0x1000fe00>;
		fuse-value =    <0x10002a00>;

		/* Common board features */
		board-rev = <110>;
		//have-nand;
		have-emmc;
		//have-audio;
		have-eth-phy;
		//have-wlan;
		//have-mipi-dsi;
		//have-hdmi;
		have-ext-rtc;
		//have-security;
		have-eeprom;
		//have-temp;
	};
};
