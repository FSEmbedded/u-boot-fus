## board/F+S/common/Kconfig
```kconfig
config FSIMX_BOARDS
	bool

if FSIMX_BOARDS

config ETHADDR_BASE
	string
	default "00:05:51:07:55:83"

config ADDFSHEADER
	bool
	default y

config FS_NBOOT_ARGS
	bool

config FS_BOARD_CFG
	bool

config FS_BOARD_COMMON
	bool
	default y

config FS_BOARD_MODE_RO
	bool "Load rootfs read-only (F&S)"
	default y
	help
	  F&S boards usually start the rootfs in read-only mode to
	  avoid any data loss when the power fails or when the board is
	  simply switched off without a proper shutdown procedure. If
	  you want a writable rootfs instead, say N here. But be warned,
	  this may be dangerous for your data!

config FS_IMAGE_COMMON
	bool
	select FS_BOARD_CFG
	default y if TARGET_FSIMX8MM || \
				TARGET_FSIMX8MN || \
				TARGET_FSIMX8MP || \
				TARGET_FSIMX8X || \
				TARGET_FSIMX8ULP || \
				TARGET_FSIMX93 || \
				TARGET_FSIMX91

config FS_CNTR_COMMON
	bool
	select FS_IMAGE_COMMON
	default y if TARGET_FSIMX8ULP || \
				TARGET_FSIMX93 || \
				TARGET_FSIMX91

config FS_BOOTROM
	bool
	default y if FS_CNTR_COMMON

config FS_DRAM_COMMON
	bool
	default y if TARGET_FSIMX8MM || \
				TARGET_FSIMX8MN || \
				TARGET_FSIMX8MP || \
				TARGET_FSIMX8X

config FS_FDT_COMMON
	bool
	default y

config FS_MMC_COMMON
	bool
	default y if !TARGET_FSIMX8X && !TARGET_FSIMX8M

config FS_ETH_COMMON
	bool
	default y

config FS_USB_COMMON
	bool
	default y if TARGET_FSIMX6 || TARGET_FSIMX6SX || TARGET_FSIMX6UL

config FS_ADD_ATF_TO_UBOOT
	bool "Add ATF (and opTEE) to U-Boot on fsimx8mm/mn/mp"
	depends on TARGET_FSIMX8MM || TARGET_FSIMX8MN || TARGET_FSIMX8MP
	help
	  Add ATF and opTEE to U-Boot. the result is in uboot-atf.fs. This
	  allows having an own ATF and opTEE that does noch depend on NBoot.
	  Please provide the images in board/F+S/NXP-Firmware/<arch>/ as
	  bl31.bin (non opTEE case) or bl31-optee.bin and bl32.bin (opTEE case).
	  <arch> is one of fsimx8mm, fsimx8mn, fsimx8mp.

config FS_USB_PWR_USBNC
	bool "Use USB PWR function from host controller"
	depends on FS_USB_COMMON
	default y if !TARGET_FSIMX8ULP && !TARGET_FSIMX93 && !TARGET_FSIMX93
	help
	  The VBUS power for a USB host port can either be switched
	  automatically in hardware by the dedicated USB controller
	  function or manually by setting the pad as a GPIO. If you
	  say N, the code will use the GPIO variant, if you say Y,
	  the dedicated controller function will be used where possible.

config FS_SPL_MEMTEST_COMMON
	bool "Activate memory test in SPL"
	depends on TARGET_FSIMX8MP || TARGET_FSIMX8MM
	select SPL_CACHE_SUPPORT
	select LIB_RAND
	select SPL_ALLOC_BD
	default n
	help
        Run a DRAM test in SPL. The board will have to be resettet after
        the test.

config FS_SELFTEST
	bool "Activate F&S U-boot selftest"
	depends on TARGET_FSIMX8MP || TARGET_FSIMX8MM || TARGET_FSIMX8MN
	default n
	help
        Runs a quick DRAM test and checks the CPU type. Writes the result to bdinfo.
		The DRAM test will write values all over the memory, so only use this, if you
		are sure, that nothing will get coruppted!
		Also sets the bootdely and all update checks to 0, so the U-boot can start as
		quick as possible

config FS_DISP_COMMON
	bool
	default y if TARGET_FSIMX6 || TARGET_FSIMX6SX || TARGET_FSIMX6UL

config FS_DISP_COUNT
	int
	depends on FS_DISP_COMMON
	default 4 if TARGET_FSIMX6
	default 2 if TARGET_FSIMX6SX
	default 1 if TARGET_FSIMX6UL

config USB_TCPC
	bool "USB Typec port controller simple driver"
	default n if TARGET_FSIMX8MP
	help
	  Enable USB type-c port controller (TCPC) driver

config FS_WINIOT_SUPPORT
	bool "Windows IoT support"
	imply FS_DEVICEINFO_COMMON
	help
	  Allow booting Windows IoT UEFI images. Calls do_bootm_linux
	  in bootm cmd if UEFI is detected.

config FS_DEVICEINFO_COMMON
        bool "Enable FS_DEVICEINFO for Windows"
		depends on FS_WINIOT_SUPPORT
        help
          Enable shared struct in RAM for Windows. Contains MAC-addresses and other
          board specific information which Windows needs. The memory address for the
		  struct is controlled by CFG_FS_DEVICEINFO_ADDR, which is processor specific.

config FUS_FORCE_DEFAULT_BOOTDELAY
	bool "force default bootdelay (F&S)"
	default n
	help
		If enabled, bootdelay defined in configs/<board>_defconfig keeps it value,
		even during chain of trust. Use this setting only for debug purpose.

endif
```

## board/F+S/fsgal/Kconfig
```kconfig
if TARGET_FSGAL

config SYS_BOARD
	default "fsgal"

config SYS_VENDOR
	default "F+S"

config SYS_SOC
	default "fsl-layerscape"

config SYS_CONFIG_NAME
	default "fsgal"

config TEXT_BASE
	default 0x96000000 if SD_BOOT || EMMC_BOOT
	default 0x82000000 if TFABOOT
	default 0x20100000

config FUS_FORCE_BOOTDELAY
	bool "force bootdelay"
	default n
	help
		If enabled, bootdelay defined in configs/<board>_defconfig keeps it value,
		even during chain of trust. Use this setting only for debug purpose.

endif
```

## board/F+S/fsimx8mp/Kconfig
```kconfig
if TARGET_FSIMX8MP

config SYS_BOARD
	default "fsimx8mp"

config SYS_VENDOR
	default "F+S"

config SYS_CONFIG_NAME
	default "fsimx8mp"

config ATF_ADDR
	hex
	default 0x00968000

config TEE_ADDR
	hex
	default 0x56000000

endif
```

## board/F+S/fsimx8ulp/Kconfig
```kconfig
if TARGET_FSIMX8ULP

config SYS_BOARD
	default "fsimx8ulp"

config SYS_VENDOR
	default "F+S"

config SYS_CONFIG_NAME
	default "fsimx8ulp"
	 
endif # TARGET_FSIMX8ULP
```

## board/F+S/fsimx8x/Kconfig
```kconfig
if TARGET_FSIMX8X

config SYS_CPU
	default "armv8"

config SYS_BOARD
	default "fsimx8x"

config SYS_VENDOR
	default "F+S"

config SYS_SOC
	default "mx8"

config SYS_CONFIG_NAME
	default "fsimx8x"

endif
```

## board/F+S/fsimx91/Kconfig
```kconfig
if TARGET_FSIMX91

config SYS_BOARD
	default "fsimx91"

config SYS_VENDOR
	default "F+S"

config SYS_CONFIG_NAME
	default "fsimx91"

endif # TARGET_FSIMX91
```

## board/F+S/fsimx93/Kconfig
```kconfig
if TARGET_FSIMX93

config SYS_BOARD
	default "fsimx93"

config SYS_VENDOR
	default "F+S"

config SYS_CONFIG_NAME
	default "fsimx93"

endif # TARGET_FSIMX93
```

## cmd/fus_selftest/Kconfig
```kconfig
menuconfig FUS_COMMON_CMD_OPTIONS
	bool "F+S specific command line interface"
	default y
	help
		Enable F+S specific commands for U-Boot

if FUS_COMMON_CMD_OPTIONS

config CMD_LCD
	bool
	default n

config CMD_DRAW
	bool
	default n

config XLCD_DRAW
	hex
	default 0x020F

config XLCD_TEST
	hex
	default 0x0001
config CMD_SELFTEST
	bool "selftest"
	default y
	select DM_RTC
	select DM_PMIC_BD71837
	#select DM_SERIAL
	select DM_SPI
	select CMD_LCD if VIDEO
	select CMD_DRAW if VIDEO
	select MXC_SPI
	help
		Standard selftest for F&S boards. The argument of the command
		is the display, that is used for the selftest.

endif   # if FUS_COMMON_CMD_OPTIONS
```

## configs/fsimx6_defconfig
```kconfig
CONFIG_ARM=y
CONFIG_SYS_ARM_CACHE_WRITETHROUGH=y
# CONFIG_USE_ARCH_MEMMOVE is not set
CONFIG_ARCH_MX6=y
CONFIG_TEXT_BASE=0x10200000
CONFIG_SYS_MALLOC_LEN=0xA00000
CONFIG_NR_DRAM_BANKS=1
CONFIG_ENV_SIZE=0x4000
CONFIG_ENV_OFFSET=0x0
CONFIG_MX6QDL=y
CONFIG_TARGET_FSIMX6=y
CONFIG_DM_GPIO=y
CONFIG_DEFAULT_DEVICE_TREE="armstonea9dl"
CONFIG_IDENT_STRING=" for F&S"
CONFIG_SYS_LOAD_ADDR=0x11000000
CONFIG_OF_BOARD_FIXUP=y
CONFIG_FIT=y
# CONFIG_SET_BOOTDELAY is not set
CONFIG_OF_BOARD_SETUP=y
CONFIG_USE_BOOTARGS=y
CONFIG_BOOTARGS="undef"
CONFIG_USE_BOOTCOMMAND=y
CONFIG_BOOTCOMMAND="run set_bootargs; run kernel; run fdt"
CONFIG_USE_PREBOOT=y
CONFIG_SYS_CBSIZE=512
CONFIG_SYS_PBSIZE=640
CONFIG_SYS_CONSOLE_IS_IN_ENV=y
CONFIG_SYS_CONSOLE_ENV_OVERWRITE=y
CONFIG_HUSH_PARSER=y
CONFIG_CMD_BOOTZ=y
# CONFIG_BOOTM_NETBSD is not set
# CONFIG_BOOTM_PLAN9 is not set
# CONFIG_BOOTM_RTEMS is not set
# CONFIG_BOOTM_VXWORKS is not set
# CONFIG_CMD_ELF is not set
CONFIG_CMD_ASKENV=y
CONFIG_CMD_ENV_CALLBACK=y
CONFIG_CMD_ENV_FLAGS=y
CONFIG_CMD_MEMTEST=y
CONFIG_CMD_UNZIP=y
# CONFIG_CMD_BIND is not set
CONFIG_CMD_DM=y
CONFIG_CMD_GPIO=y
CONFIG_CMD_GPIO_READ=y
CONFIG_CMD_I2C=y
# CONFIG_CMD_LOADB is not set
# CONFIG_CMD_LOADS is not set
CONFIG_CMD_MMC=y
CONFIG_CMD_NAND=y
CONFIG_CMD_PART=y
CONFIG_CMD_READ=y
CONFIG_CMD_USB=y
CONFIG_CMD_USB_MASS_STORAGE=y
CONFIG_CMD_UPDATE=y
CONFIG_BOOTP_DNS2=y
CONFIG_CMD_MII=y
CONFIG_CMD_CACHE=y
CONFIG_CMD_INI=y
CONFIG_CMD_GETTIME=y
CONFIG_CMD_TIMER=y
CONFIG_CMD_EXT2=y
CONFIG_CMD_EXT4=y
CONFIG_CMD_FAT=y
CONFIG_CMD_FS_GENERIC=y
CONFIG_CMD_MTDPARTS=y
CONFIG_MTDIDS_DEFAULT="undef"
CONFIG_MTDPARTS_DEFAULT="undef"
CONFIG_CMD_UBI=y
CONFIG_OF_CONTROL=y
CONFIG_OF_LIST="armstonea9dl armstonea9q armstonea9r2dl armstonea9r2q armstonea9r3dl armstonea9r3q armstonea9r4dl armstonea9r4q efusa9dl efusa9q efusa9r2dl efusa9r2q netdcua9dl netdcua9q picomoda9dl picomoda9q qblissa9dl qblissa9q qblissa9r2dl qblissa9r2q"
CONFIG_MULTI_DTB_FIT=y
CONFIG_ENV_OVERWRITE=y
CONFIG_ENV_IS_IN_NAND=y
CONFIG_ENV_NAND_EXTRA=y
CONFIG_ENV_NAND_OFFSET=0x200000
CONFIG_ENV_NAND_HAVE_RANGE=y
CONFIG_ENV_NAND_RANGE=0x40000
CONFIG_USE_BOOTFILE=y
CONFIG_BOOTFILE="zImage"
CONFIG_USE_ETHPRIME=y
CONFIG_ETHPRIME="FEC"
CONFIG_ARP_TIMEOUT=2000
CONFIG_BOOTP_SEND_HOSTNAME=y
CONFIG_SYS_FAULT_ECHO_LINK_DOWN=y
CONFIG_USE_GATEWAYIP=y
CONFIG_GATEWAYIP="10.0.0.5"
CONFIG_USE_IPADDR=y
CONFIG_IPADDR="10.0.0.252"
CONFIG_USE_NETMASK=y
CONFIG_NETMASK="255.255.255.0"
CONFIG_USE_ROOTPATH=y
CONFIG_ROOTPATH="/rootfs"
CONFIG_USE_SERVERIP=y
CONFIG_SERVERIP="10.0.0.122"
CONFIG_GPIO_HOG=y
CONFIG_DM_I2C=y
CONFIG_SYS_I2C_MXC=y
CONFIG_LED_STATUS0=y
CONFIG_LED_STATUS_BIT=0
CONFIG_LED_STATUS1=y
CONFIG_LED_STATUS_BIT1=1
CONFIG_LED_STATUS_CMD=y
CONFIG_FSL_USDHC=y
CONFIG_MTD=y
CONFIG_MTD_RAW_NAND=y
CONFIG_NAND_MXS_FUS=y
CONFIG_NAND_REFRESH=y
CONFIG_SYS_NAND_ONFI_DETECTION=y
CONFIG_PHYLIB=y
CONFIG_PHY_ATHEROS=y
CONFIG_PHY_REALTEK=y
CONFIG_RTL8211F_PHY_FORCE_EEE_RXC_ON=y
CONFIG_DM_MDIO=y
CONFIG_DM_ETH_PHY=y
CONFIG_FEC_MXC=y
# CONFIG_FEC_GET_MAC_FROM_FUSES is not set
CONFIG_PINCTRL=y
CONFIG_PINCTRL_IMX6=y
CONFIG_DM_SERIAL=y
CONFIG_MXC_UART=y
CONFIG_USB=y
CONFIG_USB_STORAGE=y
CONFIG_USB_GADGET=y
CONFIG_USB_GADGET_MANUFACTURER="FSL"
CONFIG_USB_GADGET_VENDOR_NUM=0x0525
CONFIG_USB_GADGET_PRODUCT_NUM=0xa4a5
CONFIG_CI_UDC=y
# CONFIG_FAT_ORIG is not set
CONFIG_FAT_FUS=y
# CONFIG_TOOLS_LIBCRYPTO is not set
# CONFIG_TOOLS_KWBIMAGE is not set
```

## configs/fsimx6ul_defconfig
```kconfig
CONFIG_ARM=y
CONFIG_SYS_ARM_CACHE_WRITETHROUGH=y
# CONFIG_USE_ARCH_MEMMOVE is not set
CONFIG_ARCH_MX6=y
CONFIG_TEXT_BASE=0x80200000
CONFIG_SYS_MALLOC_LEN=0xA00000
CONFIG_NR_DRAM_BANKS=1
CONFIG_ENV_SIZE=0x4000
CONFIG_ENV_OFFSET=0x0
CONFIG_MX6ULL=y
CONFIG_TARGET_FSIMX6UL=y
CONFIG_DM_GPIO=y
CONFIG_DEFAULT_DEVICE_TREE="efusa7ul"
CONFIG_IDENT_STRING=" for F&S"
CONFIG_SYS_LOAD_ADDR=0x81000000
CONFIG_OF_BOARD_FIXUP=y
CONFIG_DISASM=y
CONFIG_FIT=y
# CONFIG_SET_BOOTDELAY is not set
CONFIG_OF_BOARD_SETUP=y
CONFIG_USE_BOOTARGS=y
CONFIG_BOOTARGS="undef"
CONFIG_USE_BOOTCOMMAND=y
CONFIG_BOOTCOMMAND="run set_bootargs; run kernel; run fdt"
CONFIG_USE_PREBOOT=y
CONFIG_SYS_CBSIZE=512
CONFIG_SYS_PBSIZE=640
CONFIG_SYS_CONSOLE_IS_IN_ENV=y
CONFIG_SYS_CONSOLE_ENV_OVERWRITE=y
CONFIG_HUSH_PARSER=y
CONFIG_CMD_BOOTZ=y
# CONFIG_BOOTM_NETBSD is not set
# CONFIG_BOOTM_PLAN9 is not set
# CONFIG_BOOTM_RTEMS is not set
# CONFIG_BOOTM_VXWORKS is not set
# CONFIG_CMD_ELF is not set
CONFIG_CMD_FSIMAGE_IMX6=y
CONFIG_CMD_ASKENV=y
CONFIG_CMD_ENV_CALLBACK=y
CONFIG_CMD_ENV_FLAGS=y
CONFIG_CMD_MEMTEST=y
CONFIG_CMD_UNZIP=y
# CONFIG_CMD_BIND is not set
CONFIG_CMD_DM=y
CONFIG_CMD_GPIO=y
CONFIG_CMD_GPIO_READ=y
CONFIG_CMD_I2C=y
# CONFIG_CMD_LOADB is not set
# CONFIG_CMD_LOADS is not set
CONFIG_CMD_MMC=y
CONFIG_CMD_NAND=y
CONFIG_CMD_PART=y
CONFIG_CMD_READ=y
CONFIG_CMD_USB=y
CONFIG_CMD_USB_MASS_STORAGE=y
CONFIG_CMD_UPDATE=y
CONFIG_CMD_DHCP=y
CONFIG_BOOTP_DNS2=y
CONFIG_CMD_MII=y
CONFIG_CMD_PING=y
CONFIG_CMD_CACHE=y
CONFIG_CMD_INI=y
CONFIG_CMD_GETTIME=y
CONFIG_CMD_TIMER=y
CONFIG_CMD_EXT2=y
CONFIG_CMD_EXT4=y
CONFIG_CMD_FAT=y
CONFIG_CMD_FS_GENERIC=y
CONFIG_CMD_MTDPARTS=y
CONFIG_MTDIDS_DEFAULT="undef"
CONFIG_MTDPARTS_DEFAULT="undef"
CONFIG_CMD_UBI=y
CONFIG_OF_CONTROL=y
CONFIG_OF_LIST="cube2.0 cube2.0ull cubea7ul efusa7ul efusa7ull gar1 gar2 gar3 picocom1.2 picocoma7 picocoma7ull picocoremx6ul picocoremx6ull picocoremx6ul100 picocoremx6ull100"
CONFIG_MULTI_DTB_FIT=y
CONFIG_ENV_OVERWRITE=y
CONFIG_ENV_IS_IN_MMC=y
CONFIG_ENV_IS_IN_NAND=y
CONFIG_ENV_MMC_EXTRA=y
CONFIG_ENV_MMC_OFFSET=0x100000
CONFIG_ENV_NAND_EXTRA=y
CONFIG_ENV_NAND_OFFSET=0x200000
CONFIG_ENV_NAND_HAVE_RANGE=y
CONFIG_ENV_NAND_RANGE=0x40000
CONFIG_SYS_MMC_ENV_PART=1
CONFIG_USE_BOOTFILE=y
CONFIG_BOOTFILE="zImage"
CONFIG_USE_ETHPRIME=y
CONFIG_ETHPRIME="eth0"
CONFIG_ARP_TIMEOUT=2000
CONFIG_BOOTP_SEND_HOSTNAME=y
CONFIG_SYS_FAULT_ECHO_LINK_DOWN=y
CONFIG_USE_GATEWAYIP=y
CONFIG_GATEWAYIP="10.0.0.5"
CONFIG_USE_IPADDR=y
CONFIG_IPADDR="10.0.0.252"
CONFIG_USE_NETMASK=y
CONFIG_NETMASK="255.255.255.0"
CONFIG_USE_ROOTPATH=y
CONFIG_ROOTPATH="/rootfs"
CONFIG_USE_SERVERIP=y
CONFIG_SERVERIP="10.0.0.122"
CONFIG_GPIO_HOG=y
CONFIG_DM_I2C=y
CONFIG_DM_I2C_GPIO=y
CONFIG_SYS_I2C_MXC=y
CONFIG_LED_STATUS_CMD=y
CONFIG_FSL_USDHC=y
CONFIG_MTD=y
CONFIG_MTD_RAW_NAND=y
CONFIG_NAND_MXS_FUS=y
CONFIG_NAND_REFRESH=y
CONFIG_SYS_NAND_ONFI_DETECTION=y
CONFIG_PHYLIB=y
CONFIG_PHY_ATHEROS=y
CONFIG_PHY_MICREL=y
CONFIG_PHY_MICREL_KSZ8XXX=y
CONFIG_PHY_NATSEMI=y
CONFIG_PHY_REALTEK=y
CONFIG_RTL8211F_PHY_FORCE_EEE_RXC_ON=y
CONFIG_DM_MDIO=y
CONFIG_DM_ETH_PHY=y
CONFIG_FEC_MXC=y
# CONFIG_FEC_GET_MAC_FROM_FUSES is not set
CONFIG_PINCTRL=y
CONFIG_PINCTRL_IMX6=y
CONFIG_DM_REGULATOR=y
CONFIG_DM_REGULATOR_FIXED=y
CONFIG_DM_REGULATOR_GPIO=y
CONFIG_DM_SERIAL=y
CONFIG_MXC_UART=y
CONFIG_BLINK_IMX=y
CONFIG_USB=y
CONFIG_USB_STORAGE=y
CONFIG_USB_GADGET=y
CONFIG_USB_GADGET_MANUFACTURER="FSL"
CONFIG_USB_GADGET_VENDOR_NUM=0x0525
CONFIG_USB_GADGET_PRODUCT_NUM=0xa4a5
CONFIG_CI_UDC=y
# CONFIG_FAT_ORIG is not set
CONFIG_FAT_FUS=y
# CONFIG_TOOLS_LIBCRYPTO is not set
# CONFIG_TOOLS_KWBIMAGE is not set
```
