/*
* Copyright (C) 2024 F&S Elektronik Systeme GmbH
*
* This program is free software; you can redistribute it and/or modify
* it under the terms of the GNU General Public License version 2 as
* published by the Free Software Foundation.
*/

#define CONFIG_PICOCOREMX8ULP_MIPI_DSI
#define CONFIG_ADP_MIPI2MIPI1_BOARD_REVISION	120

#include "picocoremx8ulp.dts"

#if defined(CONFIG_PICOCOREMX8ULP_MIPI_DSI) && defined(CONFIG_PICOCOREMX8ULP_LVDS)
#error "Set only on config at a time"
#endif

adp_i2c: &fs_i2c_b {};

#include "displays/imx8ulp-adp-mipi2mipi1-ee0350et-2cp.dtsi"

&touch {
    reset-gpios = <&gpiof 0 GPIO_ACTIVE_LOW>;
	interrupt-parent = <&rp_gpioa>;
	interrupts = <18 IRQ_TYPE_LEVEL_LOW>;
};
