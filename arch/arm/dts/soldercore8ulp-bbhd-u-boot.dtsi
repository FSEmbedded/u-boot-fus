/*
 * Copyright (C) 2024 F&S Elektronik Systeme GmbH
 *
 * This program is free software; you can redistribute it and/or modify
 * it under the terms of the GNU General Public License version 2 as
 * published by the Free Software Foundation.
 */

 
#define CONFIG_SOLDERCORE8ULP_MIPI_DSI_UBOOT

#include "fsimx8ulp-ubootinc.dtsi"
