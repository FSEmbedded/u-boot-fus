&fec1 {
	// MX6UL_PAD_BOOT_MODE1__GPIO5_IO11
	phy-reset-gpios = <&gpio5 11 GPIO_ACTIVE_LOW>;
	phy-reset-duration = <1>;
	phy-reset-post-delay = <1>;
};

&ethphy0 {
	microchip,rmii-50mhz;
};

&ethphy1 {
	microchip,rmii-50mhz;
};
