/*
 * Copyright (C) 2024 F&S Elektronik Systeme GmbH
 *
 * This program is free software; you can redistribute it and/or modify
 * it under the terms of the GNU General Public License version 2 as
 * published by the Free Software Foundation.
 */
/dts-v1/;

#include "soldercore8ulp.dtsi"

/ {
	model = "F&S SolderCore8ULP";
	compatible = "fus,soldercore8ulp", "fus,fsimx8ulp", "fsl,imx8ulp";
};
