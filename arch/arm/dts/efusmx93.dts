// SPDX-License-Identifier: GPL-2.0
/*
* Copyright 2024 F&S Elektronik Systeme GmbH
*
* This program is free software; you can redistribute it and/or modify
* it under the terms of the GNU General Public License version 2 as
* published by the Free Software Foundation.
*
* This program is distributed in the hope that it will be useful,
* but WITHOUT ANY WARRANTY; without even the implied warranty of
* MERCHANTABILITY or FITNESS FOR A PARTICULAR PURPOSE.  See the
* GNU General Public License for more details.
*/

#define CONFIG_EFUSMX93_ETH_A
//#define CONFIG_EFUSMX93_ETH_B

//#define CONFIG_EFUSMX93_WLAN
//#define CONFIG_EFUSMX93_BLUETOOTH

#define CONFIG_EFUSMX93_UART_A
#define CONFIG_EFUSMX93_UART_B
#define CONFIG_EFUSMX93_UART_C
#define CONFIG_EFUSMX93_UART_C_RTS
#define CONFIG_EFUSMX93_UART_C_CTS
#define CONFIG_EFUSMX93_UART_D

#define CONFIG_EFUSMX93_I2C_A
#define CONFIG_EFUSMX93_I2C_B
#define CONFIG_EFUSMX93_I2C_C

#define CONFIG_EFUSMX93_SPI_A
#define CONFIG_EFUSMX93_SPI_A_B

#define CONFIG_EFUSMX93_CAN_A
#define CONFIG_EFUSMX93_CAN_B

#define CONFIG_EFUSMX93_SDIO_A
#define CONFIG_EFUSMX93_SDIO_B

#define CONFIG_EFUSMX93_USB_A
#define CONFIG_EFUSMX93_USB_DEV

#define CONFIG_EFUSMX93_PWM_BL
#define CONFIG_EFUSMX93_PWM_A

#define CONFIG_EFUSMX93_SAI
#define CONFIG_EFUSMX93_SGTL5000

#ifdef CONFIG_EFUSMX93_ETH_B
	#undef CONFIG_EFUSMX93_UART_C
	#undef CONFIG_EFUSMX93_UART_C_RTS
	#undef CONFIG_EFUSMX93_UART_C_CTS
	#undef CONFIG_EFUSMX93_UART_D
	#undef CONFIG_EFUSMX93_SAI
#endif

#ifdef	CONFIG_EFUSMX93_SAI
	#undef CONFIG_EFUSMX93_UART_C_CTS
#else
	#undef  CONFIG_EFUSMX93_SGTL5000
#endif

/dts-v1/;
#include <dt-bindings/usb/pd.h>
#include "efusmx93.dtsi"

/ {

	model = "F+S efuxMX93";
	compatible = "fus,efusmx93", "fsl,imx93";

	chosen {
		bootargs = "console=ttyLP0,115200";
		stdout-path = &fs_uart_a;
	};
};

#ifdef CONFIG_EFUSMX93_USB_DEV
&fs_usb_dev {
	dr_mode = "otg";
	hnp-disable;
	srp-disable;
	adp-disable;
	disable-over-current;
};
#endif
#ifdef CONFIG_EFUSMX93_USB_A
&fs_usb_a {
	dr_mode = "host";
	power-active-high;
	disable-over-current;
};
#endif
