&fec1 {
	// MX6UL_PAD_SNVS_TAMPER5__GPIO5_IO05
	phy-reset-gpios = <&gpio5 5 GPIO_ACTIVE_LOW>;
	phy-reset-duration = <1>;
	phy-reset-post-delay = <170>;
};

&fec2 {
	// MX6UL_PAD_SNVS_TAMPER6__GPIO5_IO06
	phy-reset-gpios = <&gpio5 6 GPIO_ACTIVE_LOW>;
	phy-reset-duration = <1>;
	phy-reset-post-delay = <170>;
};
