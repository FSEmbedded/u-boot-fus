&fec {
	// MX6QDL_PAD_ENET_CRS_DV__GPIO1_IO25
	phy-reset-gpios = <&gpio1 25 GPIO_ACTIVE_LOW>;
	phy-reset-duration = <1>;
	phy-reset-post-delay = <50>;
};

&ethphy0 {
	qca,clk-out-frequency = <125000000>;
	//qca,keep-pll-enabled;
	//qca,no-eee;

	vddio0: vddio-regulator {
		regulator-name = "VDDIO";
		regulator-min-microvolt = <1800000>;
		regulator-max-microvolt = <1800000>;
	};
};
