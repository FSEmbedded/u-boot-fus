// SPDX-License-Identifier: GPL-2.0
/*
 * Copyright (C) 2025 F&S Elektronik Systeme GmbH
 *
 * This program is free software; you can redistribute it and/or modify
 * it under the terms of the GNU General Public License version 2 as
 * published by the Free Software Foundation.
 */

/dts-v1/;
#include "netdcumx93.dtsi"

/ {
	model = "F&S NetDCUMX93";
};

/* -------------------- BOARD INFO -------------------- */
&bdinfo {
	board_name = "netdcumx93";
};

&pc_i2c_d {
	ioexpander: gpio-exp@21 {
			compatible = "nxp,pcal6416";
			reg = <0x21>;
			vcc-supply = <&reg_vref_3v3>;
			gpio-controller;
			#gpio-cells = <2>;
			ngpios = <16>;
	};
};

#include "picocoremx93-u-boot.dtsi"
